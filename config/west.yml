## config/west.yml
```yaml
manifest:
  remotes:
    - name: tacahiroy-zmk
      url-base: https://github.com/tacahiroy
    - name: refil-zmk
      url-base: https://github.com/refil
  projects:
    - name: zmk
      remote: tacahiroy-zmk
      revision: ckp
      import: app/west.yml
  self:
    path: config
```
